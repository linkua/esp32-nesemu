## components/nofrendo-esp32/Kconfig.projbuild
```kconfig
menu "Nofrendo ESP32-specific configuration"

choice NOFRENDO_HARDWARE
	prompt "Hardware to run on"
	default ESP_WROVER_KIT_V2_ILI
	help
		This emulator can run on various types of hardware. Select what you have here.

config HW_WROVERKIT_V1
	bool "ESP_Wrover_Kit v1 (red PCB)"

config HW_WROVERKIT_V2
	bool "ESP_Wrover_Kit v2 (black PCB)"

config HW_CUSTOM
	bool "Custom hardware"

endchoice

config SOUND_ENA
	bool "Analog audio on GPIO25"
	default n
	help 
		ESP32 will output 0-3.3V analog audio signal on GPIO25.


config HW_PSX_ENA
	bool "Enable PSX controller input"
	default y
	help
		If you connect a PSX/PS2 controller to the following GPIOs, you can control the NES.


config HW_PSX_CLK
	int "PSX controller CLK GPIO pin"
	depends on HW_PSX_ENA
	range 1 35
	default 32

config HW_PSX_DAT
	int "PSX controller DATa GPIO pin"
	depends on HW_PSX_ENA
	range 1 35
	default 35

config HW_PSX_ATT
	int "PSX controller ATTention GPIO pin"
	depends on HW_PSX_ENA
	range 1 35
	default 34

config HW_PSX_CMD
	int "PSX controller CoMmanD GPIO pin"
	depends on HW_PSX_ENA
	range 1 35
	default 33

endmenu
```

## components/screen/Kconfig
```kconfig
menu "LCD ILI9235"
    
config HW_I2S_ENA
	bool "USE I2S to r/w"
	default y
	help
		USE I2S to r/w or only use GPIO.

endmenu
```
